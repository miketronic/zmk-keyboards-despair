## boards/shields/despair/Kconfig.defconfig
```kconfig
# Copyright (c) 2024 The ZMK Contributors
# SPDX-License-Identifier: MIT

if SHIELD_DESPAIR

config ZMK_KEYBOARD_NAME
    default "Despair"

config SPI
	default y

endif
```

## boards/shields/despair/Kconfig.shield
```kconfig
# Copyright (c) 2024 The ZMK Contributors
# SPDX-License-Identifier: MIT

config SHIELD_DESPAIR
    def_bool $(shields_list_contains,despair)
```
